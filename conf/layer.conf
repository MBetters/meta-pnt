## conf/layer.conf
```bitbake
BBPATH .= ":${LAYERDIR}"

BBFILES += "${LAYERDIR}/recipes-*/*/*.bb \
            ${LAYERDIR}/recipes-*/*/*.bbappend"

BBFILE_COLLECTIONS += "pnt"
BBFILE_PATTERN_pnt = "^${LAYERDIR}/"
BBFILE_PRIORITY_pnt = "6"
```
